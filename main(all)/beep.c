#include "header.h"
#include "key8.h"
#include "beep.h"
#include "led.h"
static ulong mainLoopCount=0;

#define Beep   P1_1

#define _DO_TEST
/**************test some thing****/
#ifdef main
#undef main
#endif
#define main test_main
#ifdef main


unsigned char n=0;  //n为节拍常数变量    
unsigned char code music_tab[] ={   
0x18, 0x30, 0x1C , 0x10, //格式为: 频率常数, 节拍常数, 频率常数, 节拍常数,    
0x20, 0x40, 0x1C , 0x10,   
0x18, 0x10, 0x20 , 0x10,   
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0x18, 0x80, 0x00   
};   

typedef union U16_2{
	struct{
	u8 H;
		u8 L;
		
	}d8;
	u16 d16;
}U16_2;
U16_2 TBuffer;
ulong beepCount=0;
ulong beepLength=0;
static uchar pVoice=0; 
void int0()  interrupt 1   //采用中断0 控制节拍    
{  
   TH0=TBuffer.d8.H;   
   TL0=TBuffer.d8.L;  
   Beep=~(Beep);
   beepCount++;
   while(beepCount>=beepLength){
	   TR0=0; 
   }
}   
 
#define delay newDelay 
void delay (unsigned char m)   //控制频率延时    
{   
 unsigned i=3*m;   
 while(--i);   
}   

void myInit(){
  TMOD&=0x0f;   
  TMOD|=0x01;   
  TH0=0xd8;TL0=0xef;   
  IE=0x82;
  TR0=0; 
}
   
void main()   
{ 
  
  myInit(); 
   
while(1){
	 if(beepCount<beepLength){//singing....
	 }else{//switch to next voice.
		uchar m=music_tab[pVoice++];
		uchar n=music_tab[pVoice++];
		if(m==0x00){pVoice=0;delays(1);}
		else if(m==0xff){delayms(100);}else{
		//
		beepCount=0;
		beepLength=(ulong)n*9000; //the voice length.
		TBuffer.d16=(u16)m*20;//=T=1/f;
		beepLength/=TBuffer.d16;
		TBuffer.d16=65535-TBuffer.d16; //change to right format for timer.
		//
		TR0=1;
		}
	 }
}

}




#endif
#ifdef main
#undef main
#endif
/************end test****/



	
static void init(){
myInit();
 
}

static void mainLoop(){
#define SELECT 1

  
#if SELECT==1
if(mainLoopCount%500==0){

}
 
/**************Bug: needed to fix****/
pVoice=0;
if(isKeyPress(0)){

	    uchar m=music_tab[pVoice++];
		uchar n=music_tab[pVoice++];
		if(m==0x00){pVoice=0;delays(1);}
		else if(m==0xff){delayms(100);}else{
		
		//
		beepCount=0;
		beepLength=(ulong)n*9000; //the voice length.
		TBuffer.d16=(u16)m*20;//=T=1/f;
		beepLength/=TBuffer.d16;
		TBuffer.d16=65535-TBuffer.d16; //change to right format for timer.
		//
		TR0=1;
		}
}
if(isKeyPress(1)){
	P1_1=1;
}

#endif

#if SELECT==2
	
#endif
#if SELECT==0
	
#endif



}


int beep_main(){
#ifdef DO_TEST
test_main();
#endif
	mainLoopCount=0;
	init();
	while(1)
	{
		processKey();
		mainLoop();
		mainLoopCount++;
	}
	return 0;
}
